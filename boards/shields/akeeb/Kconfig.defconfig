## boards/shields/akeeb/Kconfig.defconfig
```kconfig
# Copyright (c) 2020 The ZMK Contributors
# SPDX-License-Identifier: MIT

if SHIELD_AKEEB

config ZMK_KEYBOARD_NAME
    default "Akeeb"

endif
```

## boards/shields/akeeb/Kconfig.shield
```kconfig
# Copyright (c) 2020 The ZMK Contributors
# SPDX-License-Identifier: MIT

config SHIELD_AKEEB
    def_bool $(shields_list_contains,akeeb)
```

## boards/shields/ferris/Kconfig.defconfig
```kconfig
# Copyright (c) 2020 The ZMK Contributors
# SPDX-License-Identifier: MIT

if SHIELD_FERRIS

config ZMK_KEYBOARD_NAME
    default "Ferris"

config ZMK_KSCAN_MATRIX_POLLING
    default y

endif
```
